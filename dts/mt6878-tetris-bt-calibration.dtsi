/* SPDX-License-Identifier: (GPL-2.0-only OR BSD-2-Clause) */

/ {
	bt@18800000 {
		compatible = "mediatek,bt";
		reg = <0 0x18800000 0 0x1000>, <0 0x18000000 0 0x1000>,
		      <0 0x18001000 0 0x1000>, <0 0x18051000 0 0x1000>,
		      <0 0x18060000 0 0x1000>, <0 0x18812000 0 0x1000>,
		      <0 0x10001000 0 0x1000>;
		interrupts = <0 0x2b5 4 0>, <0 0x84 4 0>;
	};
};
